&spi0 {
    status = "okay";

    pmw3610: pmw3610@0 {
        compatible = "pixart,pmw3610-alt";
        reg = <0>;
        spi-max-frequency = <2000000>;
        cs-gpios = <&gpio0 20 GPIO_ACTIVE_LOW>;
        irq-gpios = <&gpio0 6 GPIO_ACTIVE_LOW>;
        status = "okay";
    };
};
