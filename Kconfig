## Kconfig
```kconfig
menu "KimiBoard"

config KIMIBOARD_TRACKBALL_ROTATION
    bool "Enable KimiBoard trackball rotation helpers"
    default y

endmenu
```

## config/west.yml
```yaml
manifest:
  remotes:
    - name: zmkfirmware
      url-base: https://github.com/zmkfirmware
    - name: sirocominfo
      url-base: https://github.com/sirocominfo
    - name: caksoylar
      url-base: https://github.com/caksoylar
  projects:
    - name: zmk
      remote: zmkfirmware
      revision: v0.3
      import: app/west.yml
    - name: zmk-pmw3610-driver
      path: modules/zmk-pmw3610-driver
    - name: zmk-rgbled-widget
      remote: caksoylar
      revision: main
  self:
    path: config
```

## dts/bindings/behaviors/kimiboard,behavior-trackball-rotate.yaml
```yaml
description: KimiBoard trackball rotation behavior

compatible: "kimiboard,behavior-trackball-rotate"

include: zero_param.yaml

properties:
  clockwise:
    type: boolean
    description: Rotate clockwise by 45 degrees when pressed.
```

## dts/bindings/behaviors/kimiboard,tb-rotate.yaml
```yaml
description: KimiBoard trackball rotation behavior (local-only, no HID output)

compatible: "kimiboard,tb-rotate"

properties:
  "#binding-cells":
    type: int
    const: 0
    description: "No extra cells"

  cw:
    type: int
    required: true
    description: "1 = rotate clockwise, 0 = rotate counter-clockwise"
```
